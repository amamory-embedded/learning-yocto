## conf/layer.conf
```bitbake
# We have a conf and classes directory, add to BBPATH
BBPATH .= ":${LAYERDIR}"

# We have recipes-* directories, add to BBFILES
BBFILES += "${LAYERDIR}/recipes-*/*/*.bb \
            ${LAYERDIR}/recipes-*/*/*.bbappend"

BBFILE_COLLECTIONS += "meta-learning"
BBFILE_PATTERN_meta-learning = "^${LAYERDIR}/"
# This layer does not have complex depedencies. So, we assign priority 7
# run : bitbake-layer show-layers to show the priority of all layers
# NOTE: Starting bitbake server...
# layer                 path                                      priority
# ==========================================================================
# meta                  /opt/yocto/dunfell/src/poky/meta          5
# meta-poky             /opt/yocto/dunfell/src/poky/meta-poky     5
# meta-yocto-bsp        /opt/yocto/dunfell/src/poky/meta-yocto-bsp  5
# meta-learning         /home/build/rpi/build/meta-learning       7    <======
# meta-raspberrypi      /opt/yocto/dunfell/src/meta-raspberrypi   9
# meta-oe               /opt/yocto/dunfell/src/meta-openembedded/meta-oe  6
# meta-networking       /opt/yocto/dunfell/src/meta-openembedded/meta-networking  5
# meta-python           /opt/yocto/dunfell/src/meta-openembedded/meta-python  7
BBFILE_PRIORITY_meta-learning = "7"

LAYERDEPENDS_meta-learning = "core"
LAYERSERIES_COMPAT_meta-learning = "dunfell"

# add here the name of the recipes to be included into the image
IMAGE_INSTALL_append = " example"
IMAGE_INSTALL_append = " hello"
#IMAGE_INSTALL_append = " hellomake"
IMAGE_INSTALL_append = " hellocmake"
IMAGE_INSTALL_append = " libhello"
IMAGE_INSTALL_append = " hellodep"
IMAGE_INSTALL_append = " hellogit"
IMAGE_INSTALL_append = " hellogitcmake"

# my kernel recipes
MACHINE_EXTRA_RDEPENDS += "kernel-module-hello"
```
